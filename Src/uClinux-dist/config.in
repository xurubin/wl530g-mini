## Src/uClinux-dist/config.in
```kconfig
mainmenu_name 'uClinux Configuration'
mainmenu_option next_comment
comment 'Target Platform Selection'
comment 'Choose a Vendor/Product combination.'
choice 'Vendor/Product' "3com/PalmIIIx CONFIG_DEFAULTS_3COM_PALMIIIX \
3com/Xcopilot CONFIG_DEFAULTS_3COM_XCOPILOT \
ADI/Coyote CONFIG_DEFAULTS_ADI_COYOTE \
Arcturus/uC5272 CONFIG_DEFAULTS_ARCTURUS_UC5272 \
Arcturus/uCdimm CONFIG_DEFAULTS_ARCTURUS_UCDIMM \
Arcturus/uCdimm+mtd CONFIG_DEFAULTS_ARCTURUS_UCDIMM_MTD \
Arcturus/uCquicc CONFIG_DEFAULTS_ARCTURUS_UCQUICC \
Arcturus/uCsimm CONFIG_DEFAULTS_ARCTURUS_UCSIMM \
Arnewsh/M5206 CONFIG_DEFAULTS_ARNEWSH_M5206 \
Arnewsh/M5307 CONFIG_DEFAULTS_ARNEWSH_M5307 \
Atmel/AT91 CONFIG_DEFAULTS_ATMEL_AT91 \
Conexant/Humber CONFIG_DEFAULTS_CONEXANT_HUMBER \
Conexant/P52 CONFIG_DEFAULTS_CONEXANT_P52 \
Cwlinux/cwez328 CONFIG_DEFAULTS_CWLINUX_CWEZ328 \
Cwlinux/cwvz328 CONFIG_DEFAULTS_CWLINUX_CWVZ328 \
Cytek/NETmp3 CONFIG_DEFAULTS_CYTEK_NETMP3 \
Exys/de2 CONFIG_DEFAULTS_EXYS_DE2 \
Feith/Cleopatra2 CONFIG_DEFAULTS_FEITH_CLEOPATRA2 \
Feith/Cleopatra CONFIG_DEFAULTS_FEITH_CLEOPATRA \
GDB/ARMulator CONFIG_DEFAULTS_GDB_ARMULATOR \
GDB/ARMulator-EB CONFIG_DEFAULTS_GDB_ARMULATOR_EB \
Hitachi/BigSurIV CONFIG_DEFAULTS_HITACHI_BIGSURIV \
Hitachi/EDOSK2674 CONFIG_DEFAULTS_HITACHI_EDOSK2674 \
Hitachi/KeyWest CONFIG_DEFAULTS_HITACHI_KEYWEST \
Insight/XC2V1K_Microblaze CONFIG_DEFAULTS_INSIGHT_XC2V1K_MICROBLAZE \
Intel/IXDP425 CONFIG_DEFAULTS_INTEL_IXDP425 \
LEOX/TSIM CONFIG_DEFAULTS_LEOX_TSIM \
Marvell/Firefox CONFIG_DEFAULTS_MARVELL_FIREFOX \
Marvell/Libertas CONFIG_DEFAULTS_MARVELL_LIBERTAS \
Mecel/FR1000 CONFIG_DEFAULTS_MECEL_FR1000 \
Midas/RTE-NB85E-CB CONFIG_DEFAULTS_MIDAS_RTE_NB85E_CB \
Midas/RTE-V850E-MA1-CB CONFIG_DEFAULTS_MIDAS_RTE_V850E_MA1_CB \
Motorola/M5206eC3 CONFIG_DEFAULTS_MOTOROLA_M5206EC3 \
Motorola/M5206eLITE CONFIG_DEFAULTS_MOTOROLA_M5206ELITE \
Motorola/M5249C3 CONFIG_DEFAULTS_MOTOROLA_M5249C3 \
Motorola/M5272C3 CONFIG_DEFAULTS_MOTOROLA_M5272C3 \
Motorola/M5282C3 CONFIG_DEFAULTS_MOTOROLA_M5282C3 \
Motorola/M5307C3 CONFIG_DEFAULTS_MOTOROLA_M5307C3 \
Motorola/M5407C3 CONFIG_DEFAULTS_MOTOROLA_M5407C3 \
NEC/Anna CONFIG_DEFAULTS_NEC_ANNA \
NEC/v850e-sim-gdb CONFIG_DEFAULTS_NEC_V850E_SIM_GDB \
Netburner/CFV240 CONFIG_DEFAULTS_NETBURNER_CFV240 \
NetSilicon/NET+ARM CONFIG_DEFAULTS_NETSILICON_NET_ARM \
Nintendo/GBA CONFIG_DEFAULTS_NINTENDO_GBA \
OPENcores/or32 CONFIG_DEFAULTS_OPENCORES_OR32 \
Promise/SX6 CONFIG_DEFAULTS_PROMISE_SX6 \
Samsung/4510B CONFIG_DEFAULTS_SAMSUNG_4510B \
SecureEdge/DISKtel CONFIG_DEFAULTS_SECUREEDGE_DISKTEL \
SecureEdge/eLIA CONFIG_DEFAULTS_SECUREEDGE_ELIA \
SecureEdge/MP3 CONFIG_DEFAULTS_SECUREEDGE_MP3 \
SecureEdge/NETtel1500 CONFIG_DEFAULTS_SECUREEDGE_NETTEL1500 \
SecureEdge/NETtel3540 CONFIG_DEFAULTS_SECUREEDGE_NETTEL3540 \
SecureEdge/SecureEdge1100 CONFIG_DEFAULTS_SECUREEDGE_SECUREEDGE1100 \
SecureEdge/SecureEdge2540 CONFIG_DEFAULTS_SECUREEDGE_SECUREEDGE2540 \
SecureEdge/SecureEdge2570 CONFIG_DEFAULTS_SECUREEDGE_SECUREEDGE2570 \
SecureEdge/SecureEdge2580 CONFIG_DEFAULTS_SECUREEDGE_SECUREEDGE2580 \
SecureEdge/SecureEdge2580-JFFS CONFIG_DEFAULTS_SECUREEDGE_SECUREEDGE2580_JFFS \
SecureEdge/SecureEdgeEdna CONFIG_DEFAULTS_SECUREEDGE_SECUREEDGEEDNA \
SecureEdge/SecureEdgeNAS CONFIG_DEFAULTS_SECUREEDGE_SECUREEDGENAS \
SecureEdge/SecureEdgePCMCIA CONFIG_DEFAULTS_SECUREEDGE_SECUREEDGEPCMCIA \
SecureEdge/SecureEdgeVPN CONFIG_DEFAULTS_SECUREEDGE_SECUREEDGEVPN \
senTec/COBRA5272 CONFIG_DEFAULTS_SENTEC_COBRA5272 \
SnapGear/LITE CONFIG_DEFAULTS_SNAPGEAR_LITE \
SnapGear/PRO CONFIG_DEFAULTS_SNAPGEAR_PRO \
SnapGear/SE3400 CONFIG_DEFAULTS_SNAPGEAR_SE3400 \
SnapGear/SE4000 CONFIG_DEFAULTS_SNAPGEAR_SE4000 \
SnapGear/SME530 CONFIG_DEFAULTS_SNAPGEAR_SME530 \
SnapGear/SME550 CONFIG_DEFAULTS_SNAPGEAR_SME550 \
SnapGear/SOHO+ CONFIG_DEFAULTS_SNAPGEAR_SOHO_ \
SWARM/SWARM CONFIG_DEFAULTS_SWARM_SWARM \
TeleIP/rsc CONFIG_DEFAULTS_TELEIP_RSC \
Triscend/A7DB CONFIG_DEFAULTS_TRISCEND_A7DB \
Triscend/DevA7 CONFIG_DEFAULTS_TRISCEND_DEVA7 \
Via/EPIA CONFIG_DEFAULTS_VIA_EPIA \
Weiss/SM2010 CONFIG_DEFAULTS_WEISS_SM2010 \
" Marvell/Libertas
comment 'Kernel is linux-2.4.x'
define_bool CONFIG_DEFAULTS_KERNEL_2_4 y
choice 'Libc Version' "glibc CONFIG_DEFAULTS_LIBC_GLIBC \
uC-libc CONFIG_DEFAULTS_LIBC_UC_LIBC \
uClibc CONFIG_DEFAULTS_LIBC_UCLIBC \
" uClibc
bool 'Default all settings (lose changes)'	CONFIG_DEFAULTS_OVERRIDE
bool 'Customize Kernel Settings'			CONFIG_DEFAULTS_KERNEL
bool 'Customize Vendor/User Settings'		CONFIG_DEFAULTS_VENDOR
bool 'Update Default Vendor Settings'		CONFIG_DEFAULTS_VENDOR_UPDATE
endmenu
```
