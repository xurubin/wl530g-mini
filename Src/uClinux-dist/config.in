## Src/uClinux-dist/linux-2.4.x/arch/armnommu/config.in
```kconfig
#/*--rx201_wbr204-*/
#
# For a description of the syntax of this configuration file,
# see Documentation/kbuild/config-language.txt.
#
mainmenu_name "Linux Kernel Configuration"

define_bool CONFIG_ARM y
define_bool CONFIG_SBUS n
define_bool CONFIG_UID16 y
define_bool CONFIG_RWSEM_GENERIC_SPINLOCK y

# Begin uclinux additions -----------------------------------------------------
define_bool CONFIG_UCLINUX y
define_bool MAGIC_ROM_PTR y
# End uclinux additions -------------------------------------------------------

#------------------------------------------------------------------------------
#                         C o d e    m a t u r i t y
#------------------------------------------------------------------------------

mainmenu_option next_comment
comment 'Code maturity level options'
bool 'Prompt for development and/or incomplete code/drivers' CONFIG_EXPERIMENTAL
bool 'Prompt for obsolete code/drivers' CONFIG_OBSOLETE
endmenu

#------------------------------------------------------------------------------
#                      L o a d a b l e    M o d u l e
#------------------------------------------------------------------------------

mainmenu_option next_comment
comment 'Loadable module support'
bool 'Enable loadable module support' CONFIG_MODULES
if [ "$CONFIG_MODULES" = "y" ]; then
   bool '  Set version information on all module symbols' CONFIG_MODVERSIONS
   bool '  Kernel module loader' CONFIG_KMOD
fi
endmenu

#------------------------------------------------------------------------------
#                               S y s t e m
#------------------------------------------------------------------------------

mainmenu_option next_comment
comment 'System Type'
choice 'ARM system type' \
	 "Firefox		CONFIG_ARCH_FIREFOX \
	  Libertas		CONFIG_ARCH_LIBERTAS" Libertas

bool 'Generate big endian code' CONFIG_CPU_BIG_ENDIAN

if [ "$CONFIG_ARCH_LIBERTAS" = "y" ]; then
	choice 'Libertas machine' \
		"AP22		CONFIG_LIBERTAS_AP22  \
		 AP32		CONFIG_LIBERTAS_AP32" \
		AP32
fi

if [ "$CONFIG_ARCH_FIREFOX" = "y" ]; then
	choice 'Firefox machine' \
		"DB-88E62x8	CONFIG_FIREFOX_DBFF  \
		 RD-88E62x8	CONFIG_FIREFOX_RDFF" \
		RD-88E62x8
fi

bool '  ARM946 CPU idle' CONFIG_CPU_ARM946_CPU_IDLE
bool '  ARM946 I-Cache on' CONFIG_CPU_ARM946_I_CACHE_ON
bool '  ARM946 D-Cache on' CONFIG_CPU_ARM946_D_CACHE_ON
if [ "$CONFIG_CPU_ARM946_D_CACHE_ON" = "y" ] ; then
   bool '  Force write through caches on ARM946' \
      	        CONFIG_CPU_ARM946_WRITETHROUGH
fi

if [ "$CONFIG_ARCH_LIBERTAS" = "y" ]; then
   if [ "$CONFIG_LIBERTAS_AP32" = "y" ]; then
      choice 'System Clock' \
         "128MHz  CONFIG_128MHZ_CLOCK \
          160MHz  CONFIG_160MHZ_CLOCK" \
          128MHz
      choice 'Memory Size' \
         "8M      CONFIG_8M_MEM \
          16M     CONFIG_16M_MEM" \
          16M
   fi
fi

bool 'Default bootloader kernel arguments' CONFIG_CMDLINE_BOOL
if [ "$CONFIG_CMDLINE_BOOL" = "y" ] ; then
   string 'Initial kernel command string' CONFIG_CMDLINE \
		"console=ttyS0,38400 root=/dev/mtdblock2"
fi

bool 'Set flash/sdram size and base addr' CONFIG_SET_MEM_PARAM
if [ "$CONFIG_SET_MEM_PARAM" = "y" ]; then
   hex '(S)DRAM Base Address' DRAM_BASE 0xd0000000
   hex '(S)DRAM Size ' DRAM_SIZE 0x7c0000
   hex 'FLASH Base Address ' FLASH_MEM_BASE 0xfff00000
   hex 'FLASH Size ' FLASH_SIZE 0x100000
   hex 'ROMFS Address in FLASH ' FLASH_ROMFS_BASE 0xfff90000
   if [ "$CONFIG_LIBERTAS_AP32" = "y" ]; then
      hex 'JFFS2 Address in FLASH ' FLASH_JFFS2_BASE 0xfff80000
   fi
else
   if [ "$CONFIG_LIBERTAS_AP22" = "y" ]; then
      define_hex DRAM_BASE 0xd0000000
      define_hex DRAM_SIZE 0x7c0000
      define_hex FLASH_MEM_BASE 0xfff00000
      define_hex FLASH_SIZE 0x100000
      define_hex FLASH_ROMFS_BASE 0xfff90000
   fi
   if [ "$CONFIG_LIBERTAS_AP32" = "y" ]; then
      define_hex DRAM_BASE 0xd0000000
      if [ "$CONFIG_8M_MEM" = "y" ]; then
         define_hex DRAM_SIZE 0x7C0000
      fi
      if [ "$CONFIG_16M_MEM" = "y" ]; then
         define_hex DRAM_SIZE 0xfC0000
      fi
      define_hex FLASH_MEM_BASE 0xffc00000
      define_hex FLASH_SIZE 0x400000
      define_hex FLASH_ROMFS_BASE 0xffca0000
      define_hex FLASH_JFFS2_BASE 0xfff80000
   fi

fi

choice 'Kernel executes from' \
    "RAM	CONFIG_RAMKERNEL \
     ROM	CONFIG_ROMKERNEL" \
     ROM


if [ "$CONFIG_ARCH_LIBERTAS" = "y" ]; then
   define_bool CONFIG_NO_PGT_CACHE y
   define_bool CONFIG_CPU_ARM946 y
   define_bool CONFIG_CPU_32 y
   define_bool CONFIG_CPU_26 n
   define_bool CONFIG_CPU_WITH_CACHE y
   define_bool CONFIG_CPU_WITH_MCR_INSTRUCTION y
   define_bool CONFIG_CMDLINE_BOOL y
fi

if [ "$CONFIG_ARCH_FIREFOX" = "y" ]; then
	define_bool CONFIG_NO_PGT_CACHE y
	define_bool CONFIG_CPU_ARM946 y
	define_bool CONFIG_CPU_32 y
	define_bool CONFIG_CPU_26 n
	define_bool CONFIG_CPU_WITH_CACHE y
	define_bool CONFIG_CPU_WITH_MCR_INSTRUCTION y
	define_bool CONFIG_ROOT_CRAMFS_AS_IMAGE y
	if [ "$CONFIG_FIREFOX_DBFF" = "y" ]; then
        	define_hex DRAM_BASE 0xd0000000
	        define_hex DRAM_SIZE 0x7d6000
		define_hex FLASH_MEM_BASE 0x20000000
		define_hex FLASH_SIZE 0x800000
		define_hex FLASH_ROMFS_BASE 0x200c0000
	fi
	if [ "$CONFIG_FIREFOX_RDFF" = "y" ]; then
        	define_hex DRAM_BASE 0xd0000000
	        define_hex DRAM_SIZE 0x7d6000
		define_hex FLASH_MEM_BASE 0xffc00000
		define_hex FLASH_SIZE 0x400000
		define_hex FLASH_ROMFS_BASE 0xffca0000
	fi
fi

endmenu

#------------------------------------------------------------------------------
#                             G e n e r a l
#------------------------------------------------------------------------------

mainmenu_option next_comment
comment 'General setup'
if [ "$CONFIG_ARCH_LIBERTAS" = "y" ]; then
   bool 'PCI support' CONFIG_PCI_INTEGRATOR
   define_bool CONFIG_PCI $CONFIG_PCI_INTEGRATOR
fi
source drivers/pci/Config.in
bool 'Support hot-pluggable devices' CONFIG_HOTPLUG
if [ "$CONFIG_HOTPLUG" = "y" ]; then
   source drivers/pcmcia/Config.in
else
   define_bool CONFIG_PCMCIA n
fi
bool 'Networking support' CONFIG_NET
bool 'System V IPC' CONFIG_SYSVIPC
bool 'Reduced memory footprint' CONFIG_REDUCED_MEMORY
bool 'BSD Process Accounting' CONFIG_BSD_PROCESS_ACCT
bool 'Sysctl support' CONFIG_SYSCTL
tristate 'NWFPE math emulation' CONFIG_NWFPE
choice 'Kernel core (/proc/kcore) format' \
	"ELF		CONFIG_KCORE_ELF \
	 A.OUT		CONFIG_KCORE_AOUT" ELF
define_bool CONFIG_BINFMT_FLAT y
define_bool CONFIG_KERNEL_ELF y

if [ "$CONFIG_EXPERIMENTAL" = "y" ]; then
   bool 'Power Management support' CONFIG_PM
fi

if [ "$CONFIG_CPU_32" = "y" ]; then
   tristate 'RISC OS personality' CONFIG_ARTHUR
fi
if [ "$CONFIG_ARCH_EBSA110" = "y" -o \
     "$CONFIG_ARCH_SA1100" = "y" -o \
     "$CONFIG_ARCH_CLPS7500" = "y" -o \
     "$CONFIG_ARCH_PERSONAL_SERVER" = "y" -o \
     "$CONFIG_ARCH_CATS" = "y" -o \
     "$CONFIG_ARCH_ATMEL" = "y" -o \
     "$CONFIG_ARCH_NETARM" = "y" -o \
     "$CONFIG_ARCH_TA7S" = "y" ]; then
   bool 'Compiled-in Kernel Boot Parameter' CONFIG_CMDLINE_BOOL
   if [ "$CONFIG_CMDLINE_BOOL" = "y" ]; then
      string 'Default kernel command string' CONFIG_CMDLINE ""
   fi
fi
if [ "$CONFIG_ARCH_NETWINDER" = "y" -o \
     "$CONFIG_ARCH_EBSA110" = "y" -o   \
     "$CONFIG_ARCH_EBSA285" = "y" -o   \
     "$CONFIG_ARCH_CO285" = "y" -o     \
     "$CONFIG_ARCH_SA1100" = "y" ]; then
   bool 'Timer and CPU usage LEDs' CONFIG_LEDS
   if [ "$CONFIG_LEDS" = "y" ]; then
      if [ "$CONFIG_ARCH_NETWINDER" = "y" -o \
	   "$CONFIG_ARCH_EBSA285" = "y" -o   \
	   "$CONFIG_ARCH_CO285" = "y" -o     \
	   "$CONFIG_ARCH_SA1100" = "y" ]; then
         bool '  Timer LED' CONFIG_LEDS_TIMER
         bool '  CPU usage LED' CONFIG_LEDS_CPU
      fi
   fi
   if [ "$CONFIG_ARCH_EBSA110" = "y" ]; then
      define_bool CONFIG_LEDS_TIMER y
   fi
fi
if [ "$CONFIG_CPU_32" = "y" -a "$CONFIG_ARCH_EBSA110" != "y" -a "$CONFIG_ARCH_TA7S" != "y" ]; then
   bool 'Kernel-mode alignment trap handler' CONFIG_ALIGNMENT_TRAP
fi

bool 'm68knommu-style attached romfs in RAM support' CONFIG_RAM_ATTACHED_ROMFS
endmenu

#------------------------------------------------------------------------------
#                           N e t    D e v i c e s
#------------------------------------------------------------------------------

if [ "$CONFIG_NET" = "y" ]; then
   source net/Config.in
   mainmenu_option next_comment
   comment 'Network device support'
   bool 'Network device support?' CONFIG_NETDEVICES
   if [ "$CONFIG_NETDEVICES" = "y" ]; then
      source drivers/net/Config.in
   fi
   endmenu
   source net/ax25/Config.in
   source net/irda/Config.in
fi

#------------------------------------------------------------------------------
#                               A T E / I D E
#------------------------------------------------------------------------------

mainmenu_option next_comment
comment 'ATA/IDE/MFM/RLL support'
tristate 'ATA/IDE/MFM/RLL support' CONFIG_IDE
if [ "$CONFIG_IDE" != "n" ]; then
  source drivers/ide/Config.in
else
  define_bool CONFIG_BLK_DEV_IDE_MODES n
  define_bool CONFIG_BLK_DEV_HD n
fi
endmenu

#------------------------------------------------------------------------------
#                                  S C S I
#------------------------------------------------------------------------------

mainmenu_option next_comment
comment 'SCSI support'
tristate 'SCSI support?' CONFIG_SCSI
if [ "$CONFIG_SCSI" != "n" ]; then
   source drivers/scsi/Config.in
fi
endmenu

#------------------------------------------------------------------------------
#                                  I S D N
#------------------------------------------------------------------------------

mainmenu_option next_comment
comment 'ISDN subsystem'
tristate 'ISDN support' CONFIG_ISDN
if [ "$CONFIG_ISDN" != "n" ]; then
   source drivers/isdn/Config.in
fi
endmenu

#------------------------------------------------------------------------------
#                              C o n s o l e
#------------------------------------------------------------------------------

if [ "$CONFIG_VT" = "y" ]; then
   mainmenu_option next_comment
   comment 'Console drivers'
   if [ "$CONFIG_ARCH_ACORN" != "y" -a "$CONFIG_ARCH_EBSA110" != "y" ]; then
      bool 'VGA text console' CONFIG_VGA_CONSOLE
   fi
   bool 'Support Frame buffer devices' CONFIG_FB
   source drivers/video/Config.in
   endmenu
fi

#------------------------------------------------------------------------------
#                        M i s c    D r i v e r s
#------------------------------------------------------------------------------

source drivers/misc/Config.in
source drivers/parport/Config.in
source drivers/mtd/Config.in
source drivers/pnp/Config.in
source drivers/block/Config.in
source fs/Config.in
source drivers/char/Config.in
source drivers/usb/Config.in
source drivers/ieee1394/Config.in
source drivers/message/i2o/Config.in

#------------------------------------------------------------------------------
#                     K e r n e l    H a c k i n g
#------------------------------------------------------------------------------

mainmenu_option next_comment
comment 'Kernel hacking'

define_bool CONFIG_FRAME_POINTER y
bool 'Find REVISITS' CONFIG_REVISIT
bool 'Verbose kernel error messages' CONFIG_DEBUG_ERRORS
bool 'Verbose user fault messages' CONFIG_DEBUG_USER
bool 'Include debugging information in kernel binary' CONFIG_DEBUG_INFO
dep_bool 'Magic SysRq key' CONFIG_MAGIC_SYSRQ $CONFIG_VT
if [ "$CONFIG_CPU_26" = "y" ]; then
   bool 'Disable pgtable cache' CONFIG_NO_PGT_CACHE
fi
if [ "$CONFIG_EXPERIMENTAL" = "y" ]; then
   bool 'Kernel low-level debugging functions' CONFIG_DEBUG_LL
   if [ "$CONFIG_DEBUG_LL" = "y" ]; then
      if [ "$CONFIG_FOOTBRIDGE" = "y" ]; then
         bool 'Kernel low-level debugging messages via footbridge serial port' CONFIG_DEBUG_DC21285_PORT
      fi
   fi
   bool 'Non power-of-2 kernel allocator (EXPERIMENTAL)' CONFIG_CONTIGUOUS_PAGE_ALLOC
   dep_bool '  include /proc/mem_map' CONFIG_MEM_MAP $CONFIG_CONTIGUOUS_PAGE_ALLOC
fi

  if [ "$CONFIG_CONTIGUOUS_PAGE_ALLOC" != "y" ]; then
    bool 'Allow allocating large blocks (> 1MB) of memory' CONFIG_NO_MMU_LARGE_ALLOCS
  fi
endmenu

source crypto/Config.in
source lib/Config.in
```
